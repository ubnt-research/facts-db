/dts-v1/;

/ {

	cavium,bdk {
		EBF-BOOT-MENU-TIMEOUT = "10";
		PCIE-MODE.PORT0 = "PCIE_X1";
		PCIE-MODE.PORT1 = "PCIE_X1";
		PCIE-MODE.PORT2 = "PCIE_X1";
		PCIE-MODE.PORT3 = "PCIE_X1";
		PCIE-MODE.PORT4 = "PCIE_X1";
		PCIE-MODE.PORT5 = "PCIE_X1";
		PCIE-MAX-LINK-SPEED.PORT0 = "GEN3";
		PCIE-MAX-LINK-SPEED.PORT1 = "GEN3";
		PCIE-MAX-LINK-SPEED.PORT2 = "GEN3";
		PCIE-MAX-LINK-SPEED.PORT3 = "GEN3";
		PCIE-MAX-LINK-SPEED.PORT4 = "GEN3";
		PCIE-MAX-LINK-SPEED.PORT5 = "GEN3";
		PORTM-MODE.P0 = "Q_USGMII";
		PORTM-MODE.P1 = "1000BASE_X";
		PORTM-MODE.P2 = "25GAUI_C2M";
		PORTM-MODE.P3 = "XFI";
		PORTM-MODE.P4 = "10G_SXGMII";
		PORTM-MODE.P5 = "SGMII";
		SCLK-FREQ-MAX = "1000";
		DDR-SPEED = "2166";
		EBF-CONFIG-ATF-TRACE-MODULES = "0";
		EBF-CONFIG-ATF-TRACE-LEVEL = "0";
		EBF-CONFIG-ATF-TIMESTAMP = "0";
		GPIO-PIN-SELECT-GPIO16 = "0x278";
		GPIO-PIN-SELECT-GPIO17 = "0x279";
		GPIO-PIN-SELECT-GPIO18 = "0x27A";
		GPIO-PIN-SELECT-GPIO19 = "0x27B";
		GPIO-PIN-SELECT-GPIO24 = "0x274";
		GPIO-PIN-SELECT-GPIO26 = "0x270";
		GPIO-PIN-SELECT-GPIO27 = "0x271";
		GPIO-PIN-SELECT-GPIO25 = "0x275";
		GPIO-PIN-SELECT-GPIO30 = "0x288";
		GPIO-PIN-SELECT-GPIO31 = "0x289";
		GPIO-PIN-SELECT-GPIO32 = "0x28A";
		GPIO-PIN-SELECT-GPIO33 = "0x28B";
		GPIO-PIN-SELECT-GPIO38 = "0x280";
		GPIO-PIN-SELECT-GPIO40 = "0x284";
		GPIO-PIN-SELECT-GPIO41 = "0x285";
		GPIO-PIN-SELECT-GPIO39 = "0x281";
		SCP-FAILSAFE-TIMEOUT = "60";
	};
};
