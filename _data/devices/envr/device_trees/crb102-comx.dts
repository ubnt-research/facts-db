/dts-v1/;

/ {

	cavium,bdk {
		DDR-SPEED = "4800";
		DDR-MCT-ENCRYPTION-EN = "0";
		DDR-MCT-NUM-OF-WIN = "1";
		DDR-MCT-WIN-ADDR-LOW = "0x0";
		DDR-MCT-WIN-ADDR-HIGH = "0xFFFFFFFFFFFFF";
		DDR-MCT-EN = "0";
		DDR5-MCT-BURST-LENGTH = "1";
		DDR5-MCT-BURST-CHOP-EN = "0";
		DDR-MCT-ENC-KEY-SCRAMBLE = "1";
		DDR-MCT-DATA-BUS-WIDTH = "1";
		DDR-OUTPUT-DRV-IMP = "0";
		DDR-DDRC-DATA-BUS-WIDTH = "0";
		DDR5-PAGE-CLOSE-EN = "1";
		DDR5-PAGE-CLOSE-TIMER = "0";
		DDR5-REFRESH-MODE = "1";
		DDR5-REFRESH-MODE-TEMP = "0";
		DDR5-DDRC-2N-MODE = "0";
		DDR-WR-CRC-EN = "0";
		DDR-RD-CRC-EN = "0";
		DDR5-RD-POSTAMBLE = "1";
		DDR5-WR-PREAMBLE = "2";
		DDR5-WR-POSTAMBLE = "1";
		DDR5-RD-PREAMBLE = "3";
		DDR5-TCR-EN = "0";
		DDR-PHY-ODT-IMP-SINGLE-RANK = "60";
		DDR-PHY-ODT-IMP-DUAL-RANK = "40";
		DDR-PHY-ODT-M_ALERT-IMP = "120";
		DDR-PHY-TX-IMP = "30";
		DDR-PHY-CK-TX-IMP = "30";
		DDR-PHY-CA-TX-IMP = "30";
		DDR-PHY-CS-TX-IMP = "30";
		DDR-PHY-HDT-CTRL = "0xC8";
		DDR-PHY-INITIAL-VREF = "90";
		DDR-PHY-TX-SLEW-RISE-DQ = "0";
		DDR-PHY-TX-SLEW-FALL-DQ = "0";
		DDR-PHY-TX-SLEW-RISE-AC = "1";
		DDR-PHY-TX-SLEW-FALL-AC = "1";
		DDR-PHY-TX-SLEW-RISE-CK = "0";
		DDR-PHY-TX-SLEW-FALL-CK = "0";
		DDR-PHYCFG-SETUP-HOLD = "0";
		DDR-PHY-ADV-TRAIN-OPT = "0x28";
		DDR-X16-BYTE-SWAP-BIT-MASK = "0";
		DDR5-MEM-VREF-DQ = "0x37";
		DDR5-MEM-VREF-CA = "0x2d";
		DDR5-MEM-VREF-CS = "0xad";
		DDR5-MEM-CK-ODT-GRP-A = "2";
		DDR5-MEM-CS-ODT-GRP-A = "2";
		DDR5-MEM-CK-ODT-GRP-B = "5";
		DDR5-MEM-CS-ODT-GRP-B = "5";
		DDR5-MEM-CA-ODT-GRP-A-SINGLE-RANK = "2";
		DDR5-MEM-CA-ODT-GRP-B-SINGLE-RANK = "5";
		DDR5-MEM-CA-ODT-GRP-A-DUAL-RANK = "1";
		DDR5-MEM-CA-ODT-GRP-B-DUAL-RANK = "4";
		DDR5-MEM-DQS-RTT-PARK = "5";
		DDR5-MEM-RTT-PARK = "7";
		DDR5-MEM-RTT-WR-SINGLE-RANK = "4";
		DDR5-MEM-RTT-WR-DUAL-RANK = "3";
		DDR5-MEM-RTT-NOM-WR = "3";
		DDR5-MEM-RTT-NOM-RD = "3";
		DDR5-RX2D-TRAIN-OPT = "1";
		DDR5-TX2D-TRAIN-OPT = "1";
		DDR5-DFE-GAIN-BIAS = "3";
		EBF-BOOT-MENU-TIMEOUT = "10";
		CORECLK-FREQ-MAX = "2500";
		SCLK-FREQ-MAX = "1000";
		PCIE-MODE.PORT0 = "PCIE_X4";
		PCIE-MODE.PORT2 = "DISABLED";
		PCIE-MODE.PORT3 = "DISABLED";
		PCIE-MODE.PORT4 = "DISABLED";
		PCIE-MODE.PORT1 = "PCIE_X1";
		PCIE-MODE.PORT5 = "PCIE_X1";
		PCIE-MAX-LINK-SPEED.PORT0 = "GEN4";
		PCIE-MAX-LINK-SPEED.PORT1 = "GEN4";
		PCIE-MAX-LINK-SPEED.PORT5 = "GEN3";
		PCIE-REF-CLOCK.PORT0 = "1";
		GPIO-PIN-SELECT-GPIO16 = "0x278";
		GPIO-PIN-SELECT-GPIO17 = "0x279";
		GPIO-PIN-SELECT-GPIO18 = "0x27a";
		GPIO-PIN-SELECT-GPIO19 = "0x27b";
		GPIO-PIN-SELECT-GPIO20 = "0x253";
		GPIO-PIN-SELECT-GPIO21 = "0x255";
		GPIO-PIN-SELECT-GPIO22 = "0x254";
		GPIO-PIN-SELECT-GPIO23 = "0x256";
		GPIO-PIN-SELECT-GPIO24 = "0x274";
		GPIO-PIN-SELECT-GPIO26 = "0x270";
		GPIO-PIN-SELECT-GPIO27 = "0x271";
		GPIO-PIN-SELECT-GPIO28 = "0x296";
		GPIO-PIN-SELECT-GPIO29 = "0x2a2";
		GPIO-PIN-SELECT-GPIO30 = "0x298";
		GPIO-PIN-SELECT-GPIO31 = "0x2a4";
		GPIO-PIN-SELECT-GPIO32 = "0x299";
		GPIO-PIN-SELECT-GPIO33 = "0x2a5";
		GPIO-PIN-SELECT-GPIO34 = "0x29a";
		GPIO-PIN-SELECT-GPIO35 = "0x2a6";
		GPIO-PIN-SELECT-GPIO36 = "0x29b";
		GPIO-PIN-SELECT-GPIO37 = "0x2a7";
		GPIO-PIN-SELECT-GPIO43 = "0x297";
		GPIO-PIN-SELECT-GPIO44 = "0x2a3";
		PORTM-MODE.P0 = "O_USGMII";
		PORTM-MODE.P1 = "10G_QXGMII";
		PORTM-MODE.P2 = "XFI";
		PORTM-MODE.P3 = "XFI";
		PORTM-MODE.P4 = "XFI";
		PORTM-MODE.P5 = "SGMII";
		DDR-PRESERVE-USERDEF-REGION-SIZE = "0";
		DDR-PRESERVE-RAMOOPS-REGION-SIZE = "16";
		DDR-SPD-ADDR.DSS0 = "0x3050";
		SCP-FAILSAFE-TIMEOUT = "60";

		pcie-ep-identity {
			PCIE-EP-OVERRIDE-IDENTITY = "0";
		};
	};
};
